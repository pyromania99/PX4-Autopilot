## src/modules/mc_controller/Kconfig
```kconfig
menuconfig MODULES_MC_CONTROLLER
	bool "mc_controller (pluggable multicopter controller framework)"
	default n
	select MODULES_MC_POS_CONTROL
	select MODULES_MC_ATT_CONTROL
	select MODULES_MC_RATE_CONTROL
	---help---
		Pluggable multicopter controller framework.

		Selects the stock multicopter control modules for three reasons: the
		CommandFrontEnd reuses mc_pos_control's Takeoff library, the CommandFrontEnd
		and VehicleStateProvider bind MPC_*/MC_* parameters that only exist when the
		owning module is enabled, and MC_CTRL_ALG=0 must remain available so the
		stock cascade is always one parameter and a reboot away.

		The control laws under controllers/ do NOT link PositionControl,
		AttitudeControl or RateControl - they implement their own maths.

menuconfig USER_MC_CONTROLLER
	bool "mc_controller running as userspace module"
	default n
	depends on BOARD_PROTECTED && MODULES_MC_CONTROLLER
	---help---
		Put mc_controller in userspace memory
```
